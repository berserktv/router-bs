## meta-router-bs/conf/layer.conf
```bitbake
# We have a conf and classes directory, add to BBPATH
BBPATH .= ":${LAYERDIR}"

# We have a packages directory, add to BBFILES
BBFILES += "${LAYERDIR}/recipes-*/*/*.bb \
            ${LAYERDIR}/recipes-*/*/*.bbappend"


# Router-bs (Router BerSerk)
BBFILE_COLLECTIONS += "bs"
BBFILE_PATTERN_bs := "^${LAYERDIR}/"
BBFILE_PRIORITY_bs = "5"

# динамический слой, подключается по имени коллекции BBFILE_COLLECTIONS+=raspberrypi,
# т.е. только в том случае, если используется слой meta-raspberrypi
BBFILES_DYNAMIC += " \
    raspberrypi:${LAYERDIR}/dynamic-layers/raspberrypi/*/*/*.bb \
    raspberrypi:${LAYERDIR}/dynamic-layers/raspberrypi/*/*/*.bbappend \
"

# увеличиваю количество виртуальных консолей до 3
SYSVINIT_ENABLED_GETTYS = "1 2 3"

# Init Systemd
DISTRO_FEATURES_append = " systemd "
DISTRO_FEATURES_BACKFILL_CONSIDERED = "sysvinit"
VIRTUAL-RUNTIME_init_manager = "systemd"
VIRTUAL-RUNTIME_initscripts = ""

# переключения загрузчика на U-Boot
RPI_USE_U_BOOT = "1"
PREFERRED_PROVIDER_u-boot-fw-utils = "libubootenv"

# включение отладки по UART
ENABLE_UART = "1"

# ядро Linux, которое содержит дополнительную служебную информацию для U-Boot
KERNEL_IMAGETYPE = "uImage"
# для обновления используется сжатая версия корневой файловой системы rootfs (ext4)
# образ дистрибутива подготавливается с использованием механизма wic (разбиение на логические разделы)
IMAGE_FSTYPES += " wic ext4.gz"
IMAGE_INSTALL_append = " kernel-image kernel-modules"
# указание wic сценария для разбиения на логические разделы (rpi см. SOC_FAMILY для MACHINEOVERRIDES)
WKS_FILES_rpi = "ts-raspberrypi.wks"

# отключаю обновление файла fstab (/mountpoint) при создании wic образа
# fstab добавляется вручную (рецепт base-files), так как он должен присутствовать как в /rootfs (wic), так и в update-image (ext4.gz)
WIC_CREATE_EXTRA_ARGS = "--no-fstab-update"

LAYERSERIES_COMPAT_bs = "gatesgarth"
```
